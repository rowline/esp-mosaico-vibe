## projects/ble_diag/sdkconfig.defaults
```kconfig
# ESP-Mosaico chip, flash and PSRAM (application template values).
CONFIG_IDF_TARGET="esp32s31"
CONFIG_IDF_EXPERIMENTAL_FEATURES=y
CONFIG_ESP_DEFAULT_CPU_FREQ_MHZ_320=y
CONFIG_ESPTOOLPY_FLASHMODE_QIO=y
CONFIG_ESPTOOLPY_FLASHFREQ_80M=y
CONFIG_ESPTOOLPY_FLASHSIZE_16MB=y
CONFIG_SPIRAM=y
CONFIG_SPIRAM_SPEED_250M=y
CONFIG_SPIRAM_XIP_FROM_PSRAM=y
CONFIG_SPIRAM_ALLOW_BSS_SEG_EXTERNAL_MEMORY=y
CONFIG_ESP_MAIN_TASK_STACK_SIZE=8192

# ESP-Mosaico application contract (hello_world template). Iris runs on USB
# only: no TCP transport, so nothing here starts Wi-Fi.
CONFIG_PARTITION_TABLE_CUSTOM=y
CONFIG_PARTITION_TABLE_CUSTOM_FILENAME="partitions.csv"
CONFIG_PARTITION_TABLE_OFFSET=0x8000
CONFIG_ESP_COREDUMP_ENABLE_TO_FLASH=y
CONFIG_APP_RETRIEVE_LEN_ELF_SHA=64
CONFIG_BOOTLOADER_APP_ROLLBACK_ENABLE=y
CONFIG_FACTORY_RECOVERY_BOOT_GPIO=7
CONFIG_FACTORY_RECOVERY_BOOT_DEBOUNCE_MS=50
CONFIG_ESP_CONSOLE_UART_DEFAULT=y
CONFIG_ESP_CONSOLE_SECONDARY_NONE=y
CONFIG_ESP_IRIS_TRANSPORT_USB=y
# CONFIG_ESP_IRIS_TRANSPORT_TCP is not set
CONFIG_ESP_IRIS_NVS_PARTITION_NAME="sysmeta"
CONFIG_ESP_IRIS_TRANSPORT_CLAIM_TIMEOUT_MS=2000
CONFIG_ESP_IRIS_TASK_STACK_SIZE=3328
CONFIG_ESP_IRIS_USB_TASK_STACK_SIZE=2048
CONFIG_ESP_IRIS_SERVICE_STACK_SIZE=4096
CONFIG_ESP_IRIS_SERVICE_PERSISTENT=y
CONFIG_ESP_IRIS_SERVICE_CONTEXT_PSRAM=y
CONFIG_ESP_IRIS_SERVICE_STATE_PSRAM=y
CONFIG_ESP_IRIS_RPC_RESPONSE_PSRAM=y
CONFIG_ESP_IRIS_WIRE_BUFFERS_PSRAM=y
CONFIG_ESP_IRIS_LOG_RING_BYTES=4096
CONFIG_ESP_IRIS_LOG_RING_STORAGE_PSRAM=y
CONFIG_ESP_IRIS_MEDIA_BUFFER_PSRAM=y
CONFIG_TINYUSB_CDC_RX_BUFSIZE=1024
CONFIG_TINYUSB_CDC_TX_BUFSIZE=1024
CONFIG_TINYUSB_CDC_EP_BUFSIZE=512
# CONFIG_ESP_IRIS_OTA is not set
CONFIG_ESP_IRIS_USB_PRODUCT="ESP-Iris Mosaico ble_diag"
CONFIG_ESP_IRIS_HEALTH_TIMEOUT_MS=45000

# Bluetooth LE with NimBLE, all four GAP roles.
CONFIG_BT_ENABLED=y
CONFIG_BT_NIMBLE_ENABLED=y
CONFIG_BT_NIMBLE_ROLE_BROADCASTER=y
CONFIG_BT_NIMBLE_ROLE_PERIPHERAL=y
CONFIG_BT_NIMBLE_ROLE_OBSERVER=y
CONFIG_BT_NIMBLE_ROLE_CENTRAL=y
```

## projects/muse_gadget/components/mosaico_presence/Kconfig
```kconfig
menu "Presence greeting"

    config MOSAICO_PRESENCE_NAME
        string "Name in the greeting"
        default ""
        help
            Who the greeting addresses, as in "晚上好，<name>！". Leave it
            empty for a greeting without a name.

    config MOSAICO_PRESENCE_TZ
        string "Time zone (POSIX TZ)"
        default "CST-8"
        help
            Picks the greeting for the time of day. CST-8 is China Standard
            Time (UTC+8).

    config MOSAICO_PRESENCE_NTP_SERVER
        string "NTP server"
        default "ntp.aliyun.com"
        help
            Sets the clock once Wi-Fi is up. Until then the greeting leaves
            out the time of day.

endmenu
```

## projects/muse_gadget/components/mosaico_tts/Kconfig
```kconfig
menu "Muse voice (ESP-Mosaico)"

    config MOSAICO_TTS_URL
        string "Speech server URL"
        default ""
        help
            An OpenAI-style /v1/audio/speech endpoint on the LAN that streams
            16-bit mono PCM (response_format "pcm", rate in the
            x-audio-sample-rate header), such as a computer's Qwen3-TTS
            service: http://<address>:<port>/v1/audio/speech. The board asks
            for "sample_rate": 16000 and "pace": 1.5 (a second ahead, then
            1.5 times speech), which a server may ignore at the cost of
            Wi-Fi memory. It says every
            reply, Chinese or English; when it can't be reached, Chinese is
            said by esp-sr on the board. Empty: esp-sr only. It names a
            machine on one network, so set it in sdkconfig.local.

    config MOSAICO_TTS_VOICE
        string "Speech server voice"
        default "vivian"
        help
            The server's voice name, as its /health lists them.

    config MOSAICO_TTS_BENCH
        bool "Bench RPCs over ESP-Iris (debugging)"
        default n
        help
            ESP-Iris RPC service 29524 (tts_bench.c): 1 fetches speech from
            the server (and plays it), 2 hammers PSRAM data from both cores,
            3 reads both cores' PMP registers. Used to reproduce and pin down
            the PSRAM crashes of 2026-10-04/05.

endmenu
```
